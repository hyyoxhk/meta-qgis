## conf/layer.conf
```bitbake
# We have a conf and classes directory, add to BBPATH
BBPATH .= ":${LAYERDIR}"

# We have a recipes directory, add to BBFILES
BBFILES += "${LAYERDIR}/recipes-*/*/*.bb \
	${LAYERDIR}/recipes-*/*/*.bbappend"

BBFILE_COLLECTIONS += "qgis-layer"
BBFILE_PATTERN_qgis-layer := "^${LAYERDIR}/"
BBFILE_PRIORITY_qgis-layer = "6"

LAYERSERIES_COMPAT_qgis-layer = "kirkstone"

LAYERDEPENDS_qgis-layer = "openembedded-layer"
```
